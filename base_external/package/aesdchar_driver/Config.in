## base_external/package/aesdchar_driver/Config.in
```kconfig
config BR2_PACKAGE_AESDCHAR_DRIVER
	bool "aesdchar_driver"
	help
	  Building and Installing the aesdchar driver in rootfs.
```

## base_external/package/ldd/Config.in
```kconfig
config BR2_PACKAGE_LDD
	bool "ldd"
	help
	  LDD module building and installing the misc-modules and scull
```
